## sdkconfig.defaults
```kconfig
# Reduce bootloader log verbosity
CONFIG_BOOTLOADER_LOG_LEVEL_WARN=y
CONFIG_BOOTLOADER_LOG_LEVEL=2

# Increase main task stack size
CONFIG_ESP_MAIN_TASK_STACK_SIZE=7168

# Enable filesystem
CONFIG_PARTITION_TABLE_CUSTOM=y
CONFIG_PARTITION_TABLE_CUSTOM_FILENAME="partitions_example.csv"
CONFIG_PARTITION_TABLE_FILENAME="partitions_example.csv"

# Enable FreeRTOS stats formatting functions, needed for 'tasks' command
CONFIG_FREERTOS_USE_TRACE_FACILITY=y
CONFIG_FREERTOS_USE_STATS_FORMATTING_FUNCTIONS=y

CONFIG_ESPTOOLPY_FLASHSIZE_4MB=y

# esp-camera needs bigger isr stack
CONFIG_FREERTOS_ISR_STACKSIZE=2048

# Move other things to core 1
CONFIG_LWIP_TCPIP_TASK_AFFINITY_CPU1=y
CONFIG_LWIP_TCPIP_TASK_AFFINITY=0x1
CONFIG_TCPIP_TASK_AFFINITY_CPU1=y
CONFIG_TCPIP_TASK_AFFINITY=0x1

CONFIG_ESP32_REV_MIN=1
CONFIG_ESP32_REV_MIN_1=y
CONFIG_ESP32_DPORT_WORKAROUND=y

CONFIG_ESP32_DEFAULT_CPU_FREQ_240=y
CONFIG_ESP32_DEFAULT_CPU_FREQ_MHZ=240

# Use PSRAM
CONFIG_ESP32_SPIRAM_SUPPORT=y
CONFIG_SPIRAM_USE_CAPS_ALLOC=y
CONFIG_SPIRAM_SUPPORT=y
CONFIG_SPIRAM_TYPE_AUTO=y
CONFIG_SPIRAM_BOOT_INIT=y
CONFIG_WIFI_LWIP_ALLOCATION_FROM_SPIRAM_FIRST=y
CONFIG_SPIRAM_CACHE_WORKAROUND=y
CONFIG_SPIRAM_TRY_ALLOCATE_WIFI_LWIP=y
CONFIG_SPIRAM_ALLOW_BSS_SEG_EXTERNAL_MEMORY=y

# esp-camera config
CONFIG_OV2640_SUPPORT=y
CONFIG_CAMERA_CORE1=y
CONFIG_SCCB_HARDWARE_I2C=y

# My custom config
CONFIG_PREFER_PSRAM=y


CONFIG_MICRO_RTSP_SERVER=y
CONFIG_MICRO_RTSP_PORT_8554=y
CONFIG_ESP32_CAMERA_CONFIG_AITHINKER=y
CONFIG_ESP32_CAMERA_FRAMESIZE_SVGA=y
```
